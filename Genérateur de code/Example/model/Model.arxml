AUTOSAR XML (schema 4.0)
ar-package:
  module config Os_R_SC1: definition=Os, implementation-config-variant=RECOMMENDED-CONFIGURATION, module-description=Os_impl  # Recommended starting configuration for Os in scalability class 1. It contains 2 periodic tasks.
    OsAlarm_100ms (OsAlarm): OsAlarmCounterRef=SystemCounter
      OsAlarmAction
        OsAlarmActivateTask: OsAlarmActivateTaskRef=OsTask_100ms
      OsAlarmAutostart: OsAlarmAutostartType=ABSOLUTE, OsAlarmCycleTime=100, OsAlarmAlarmTime=150, OsAlarmAppModeRef=OsAppModeDefault
    OsAlarm_5ms (OsAlarm): OsAlarmCounterRef=SystemCounter
      OsAlarmAction
        OsAlarmActivateTask: OsAlarmActivateTaskRef=OsTask_5ms
      OsAlarmAutostart: OsAlarmAutostartType=ABSOLUTE, OsAlarmCycleTime=5, OsAlarmAlarmTime=100, OsAlarmAppModeRef=OsAppModeDefault
    OsAppModeDefault (OsAppMode)
    OsIsr_SoftIsr4 (OsIsr): OsIsrCore=p0, OsIsrCategory=CATEGORY_2, OsIsrVectorAddress=4, OsIsrStackSize=400, OsIsrPriority=5
    OsOS:
      OsNumberOfCores = 1
      OsTickPeriod = 0.001
      OsGenerateMemmap = 1
      OsGenerateLinkerFile = 1
      OsUseOrti = 1
      OsTickTimer = DECREMENTER
      OsGenerateMakefile = 1
      OsStackMonitoring = 0
      OsVleInstructionUsed = 1
      OsUseGetServiceId = 0
      OsUseParameterAccess = 0
      OsUseResScheduler = 0
      OsCore = p0
      OsTarget = mpc5643
      OsStatus = STANDARD
      OsScalabilityClass = SC1
      OsHooks: OsErrorHook=0, OsPostTaskHook=0, OsPreTaskHook=0, OsProtectionHook=0, OsShutdownHook=0, OsStartupHook=0, OsExceptionHook=0
    OsTask_100ms (OsTask): OsTaskSchedule=FULL, OsTaskActivation=1, OsTaskPriority=10, OsTaskStackSize=500
    OsTask_5ms (OsTask): OsTaskSchedule=FULL, OsTaskActivation=1, OsTaskPriority=15, OsTaskStackSize=500
    SystemCounter (OsCounter): OsCounterType=HARDWARE, OsCounterMaxAllowedValue=65535, OsCounterMinCycle=1, OsSecondsPerTick=0.001, OsCounterTicksPerBase=1
